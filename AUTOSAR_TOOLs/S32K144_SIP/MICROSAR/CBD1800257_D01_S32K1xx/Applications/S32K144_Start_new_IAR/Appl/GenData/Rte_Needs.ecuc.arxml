AUTOSAR XML (schema 4-0-3)
package /DaVinci_Project
  module config Com
    ComConfig
      5 x ComSignal:
        lwt_sig_recv2_RearLeftWinPos_olwt_msg_recv2_oCAN00_1d859839_Rx: ComSignalType=UINT8
        lwt_sig_recv2_RearRightWinPos_olwt_msg_recv2_oCAN00_b5508b86_Rx: ComSignalType=UINT8
        lwt_sig_trans2_FrongLight_olwt_msg_transmit2_oCAN00_65e2995e_Tx: ComSignalType=BOOLEAN
        sig_LampCnt_omsg_MyECU_Lamp_oCAN00_f37e68ea_Tx: ComSignalType=UINT8
        sig_RearInteriorLight_omsg_Transmit_oCAN00_49a633c1_Tx: ComSignalType=BOOLEAN
  module config Rte
    19 x RteBswModuleInstance:
      Adc
      BswM
        BswM_MainFunctionTimingEvent0 (RteBswEventToTaskMapping): RteBswUsedOsEventRef=Rte_Ev_Cyclic2_OsTask_BSW_SCHM_0_10ms, RteBswUsedOsAlarmRef=Os/Rte_Al_TE2_OsTask_BSW_SCHM_0_10ms
      Can
        3 x RteBswEventToTaskMapping, all with RteBswUsedOsEventRef=Rte_Ev_Cyclic2_OsTask_BSW_SCHM_0_10ms, RteBswUsedOsAlarmRef=Os/Rte_Al_TE2_OsTask_BSW_SCHM_0_10ms:
          Can_MainFunction_BusOffTimingEvent0
          Can_MainFunction_ModeTimingEvent0
          Can_MainFunction_WakeupTimingEvent0
      CanIf
      CanSM
        CanSM_MainFunctionTimingEvent0 (RteBswEventToTaskMapping): RteBswUsedOsEventRef=Rte_Ev_Cyclic2_OsTask_BSW_SCHM_0_10ms, RteBswUsedOsAlarmRef=Os/Rte_Al_TE2_OsTask_BSW_SCHM_0_10ms
      CanTp
        CanTp_MainFunctionTimingEvent0 (RteBswEventToTaskMapping): RteBswUsedOsEventRef=Rte_Ev_Run_CanTp_CanTp_MainFunction, RteBswUsedOsAlarmRef=Os/Rte_Al_TE_CanTp_CanTp_MainFunction
      Com
        Com_MainFunctionRxTimingEvent0 (RteBswEventToTaskMapping): RteBswUsedOsEventRef=Rte_Ev_Cyclic2_OsTask_BSW_SCHM_0_10ms, RteBswUsedOsAlarmRef=Os/Rte_Al_TE2_OsTask_BSW_SCHM_0_10ms
        Com_MainFunctionTxTimingEvent0 (RteBswEventToTaskMapping): RteBswUsedOsEventRef=Rte_Ev_Cyclic2_OsTask_BSW_SCHM_0_10ms, RteBswUsedOsAlarmRef=Os/Rte_Al_TE2_OsTask_BSW_SCHM_0_10ms
      ComM
        ComM_MainFunction_0TimingEvent0 (RteBswEventToTaskMapping): RteBswUsedOsEventRef=Rte_Ev_Cyclic2_OsTask_BSW_SCHM_0_20ms, RteBswUsedOsAlarmRef=Os/Rte_Al_TE2_OsTask_BSW_SCHM_0_20ms
      Dcm
        Dcm_MainFunctionTimingEvent0 (RteBswEventToTaskMapping): RteBswUsedOsEventRef=Rte_Ev_Cyclic2_OsTask_BSW_SCHM_0_10ms, RteBswUsedOsAlarmRef=Os/Rte_Al_TE2_OsTask_BSW_SCHM_0_10ms
      Dem
        Dem_MasterMainFunctionTimingEvent0 (RteBswEventToTaskMapping): RteBswUsedOsEventRef=Rte_Ev_Cyclic2_OsTask_BSW_SCHM_0_10ms, RteBswUsedOsAlarmRef=Os/Rte_Al_TE2_OsTask_BSW_SCHM_0_10ms
        Dem_SatelliteMainFunctionTimingEvent0 (RteBswEventToTaskMapping): RteBswUsedOsEventRef=Rte_Ev_Cyclic2_OsTask_BSW_SCHM_0_10ms, RteBswUsedOsAlarmRef=Os/Rte_Al_TE2_OsTask_BSW_SCHM_0_10ms
      Det
      Dio
      EcuM
        EcuM_MainFunctionTimingEvent0 (RteBswEventToTaskMapping): RteBswUsedOsEventRef=Rte_Ev_Cyclic2_OsTask_BSW_SCHM_0_10ms, RteBswUsedOsAlarmRef=Os/Rte_Al_TE2_OsTask_BSW_SCHM_0_10ms
      Gpt
      Mcu
      PduR
      Port
      Pwm
      Spi
        Spi_MainFunction_HandlingTimingEvent0 (RteBswEventToTaskMapping)
    17 x RteSwComponentInstance:
      BswM_EcuSwComposition
        Timer_BswM_MainFunction (RteEventToTaskMapping): RteUsedOsEventRef=Rte_Ev_Cyclic2_OsTask_BSW_SCHM_0_10ms, RteUsedOsAlarmRef=Os/Rte_Al_TE2_OsTask_BSW_SCHM_0_10ms
      CCC_EcuSwComposition
        TMT_CCC_expand_Runnable_2S (RteEventToTaskMapping): RteUsedOsEventRef=Rte_Ev_Run_CCC_CCC_expand_Runnable_2S, RteUsedOsAlarmRef=Os/Rte_Al_TE_CCC_CCC_expand_Runnable_2S
      CPULoad_EcuSwComposition
        TMT_CPUload_basic_Runnable_1S (RteEventToTaskMapping): RteUsedOsAlarmRef=Os/Rte_Al_TE_CPULoad_CPUload_basic_Runnable_1S
      Cdd_SBC_UJA1169_EcuSwComposition
        TMT_Sbc_Test_Runnable (RteEventToTaskMapping): RteUsedOsEventRef=Rte_Ev_Run_Cdd_SBC_UJA1169_Sbc_Test_Runnable, RteUsedOsAlarmRef=Os/Rte_Al_TE_Cdd_SBC_UJA1169_Sbc_Test_Runnable
      ComM_EcuSwComposition
        Timer_ComM_MainFunction_0 (RteEventToTaskMapping): RteUsedOsEventRef=Rte_Ev_Cyclic2_OsTask_BSW_SCHM_0_20ms, RteUsedOsAlarmRef=Os/Rte_Al_TE2_OsTask_BSW_SCHM_0_20ms
      CpLedTask_EcuSwComposition
        TMT_LedRunnable (RteEventToTaskMapping): RteUsedOsEventRef=Rte_Ev_Run_CpLedTask_LedRunnable, RteUsedOsAlarmRef=Os/Rte_Al_TE_CpLedTask_LedRunnable
      Dcm_EcuSwComposition
        Timer_Dcm_MainFunction (RteEventToTaskMapping): RteUsedOsEventRef=Rte_Ev_Cyclic2_OsTask_BSW_SCHM_0_10ms, RteUsedOsAlarmRef=Os/Rte_Al_TE2_OsTask_BSW_SCHM_0_10ms
      DemMaster_0_EcuSwComposition
        Timer_Dem_MasterMainFunction (RteEventToTaskMapping): RteUsedOsEventRef=Rte_Ev_Cyclic2_OsTask_BSW_SCHM_0_10ms, RteUsedOsAlarmRef=Os/Rte_Al_TE2_OsTask_BSW_SCHM_0_10ms
      DemSatellite_0_EcuSwComposition
        Timer_Dem_SatelliteMainFunction (RteEventToTaskMapping): RteUsedOsEventRef=Rte_Ev_Cyclic2_OsTask_BSW_SCHM_0_10ms, RteUsedOsAlarmRef=Os/Rte_Al_TE2_OsTask_BSW_SCHM_0_10ms
      Det_EcuSwComposition
      EMC_EcuSwComposition
        TMT_EMC_expand_Runnable_10ms (RteEventToTaskMapping): RteUsedOsEventRef=Rte_Ev_Run_EMC_EMC_expand_Runnable_10ms, RteUsedOsAlarmRef=Os/Rte_Al_TE_EMC_EMC_expand_Runnable_10ms
      EcuM_EcuSwComposition
        Timer_EcuM_MainFunction (RteEventToTaskMapping): RteUsedOsEventRef=Rte_Ev_Cyclic2_OsTask_BSW_SCHM_0_10ms, RteUsedOsAlarmRef=Os/Rte_Al_TE2_OsTask_BSW_SCHM_0_10ms
      LOCK_EcuSwComposition
        TMT_LOCK_basic_Runnable (RteEventToTaskMapping): RteUsedOsAlarmRef=Os/Rte_Al_TE_LOCK_LOCK_basic_Runnable
      Os_OsCore0_swc_EcuSwComposition
      PWL_EcuSwComposition
        TMT_PWL_expand_Runnable_20ms (RteEventToTaskMapping): RteUsedOsEventRef=Rte_Ev_Run_PWL_PWL_expand_Runnable_20ms, RteUsedOsAlarmRef=Os/Rte_Al_TE_PWL_PWL_expand_Runnable_20ms
      Test2_SWC_EcuSwComposition
        TMT_Test_SWC2_Main (RteEventToTaskMapping): RteUsedOsEventRef=Rte_Ev_Cyclic_OsTask_APP_0_50ms, RteUsedOsAlarmRef=Os/Rte_Al_TE_OsTask_APP_0_50ms
      Test_SWC_EcuSwComposition
        TMT_Test_SWC_Main (RteEventToTaskMapping): RteUsedOsEventRef=Rte_Ev_Cyclic_OsTask_APP_0_50ms, RteUsedOsAlarmRef=Os/Rte_Al_TE_OsTask_APP_0_50ms
    RteOsInteraction
      11 x RteUsedOsActivation, all with RteExpectedActivationOffset=0:
        Rte_Al_TE_Cdd_SBC_UJA1169_Sbc_Test_Runnable: RteActivationOsAlarmRef=Os/Rte_Al_TE_Cdd_SBC_UJA1169_Sbc_Test_Runnable, RteActivationOsTaskRef=OsTask_APP
        Rte_Al_TE_CpLedTask_LedRunnable: RteActivationOsAlarmRef=Os/Rte_Al_TE_CpLedTask_LedRunnable, RteActivationOsTaskRef=OsTask_APP
        Rte_Al_TE_OsTask_APP_0_50ms: RteActivationOsAlarmRef=Os/Rte_Al_TE_OsTask_APP_0_50ms, RteActivationOsTaskRef=OsTask_APP
        Rte_Al_TE2_OsTask_BSW_SCHM_0_10ms: RteActivationOsAlarmRef=Os/Rte_Al_TE2_OsTask_BSW_SCHM_0_10ms, RteActivationOsTaskRef=OsTask_BSW_SCHM
        Rte_Al_TE2_OsTask_BSW_SCHM_0_20ms: RteActivationOsAlarmRef=Os/Rte_Al_TE2_OsTask_BSW_SCHM_0_20ms, RteActivationOsTaskRef=OsTask_BSW_SCHM
        Rte_Al_TE_CanTp_CanTp_MainFunction: RteActivationOsAlarmRef=Os/Rte_Al_TE_CanTp_CanTp_MainFunction, RteActivationOsTaskRef=OsTask_BSW_SCHM
        Rte_Al_TE_CPULoad_CPUload_basic_Runnable_1S: RteActivationOsAlarmRef=Os/Rte_Al_TE_CPULoad_CPUload_basic_Runnable_1S, RteActivationOsTaskRef=OsTask_CPULoad_1S
        Rte_Al_TE_CCC_CCC_expand_Runnable_2S: RteActivationOsAlarmRef=Os/Rte_Al_TE_CCC_CCC_expand_Runnable_2S, RteActivationOsTaskRef=OsTask_EMC_PWL_CCC
        Rte_Al_TE_EMC_EMC_expand_Runnable_10ms: RteActivationOsAlarmRef=Os/Rte_Al_TE_EMC_EMC_expand_Runnable_10ms, RteActivationOsTaskRef=OsTask_EMC_PWL_CCC
        Rte_Al_TE_PWL_PWL_expand_Runnable_20ms: RteActivationOsAlarmRef=Os/Rte_Al_TE_PWL_PWL_expand_Runnable_20ms, RteActivationOsTaskRef=OsTask_EMC_PWL_CCC
        Rte_Al_TE_LOCK_LOCK_basic_Runnable: RteActivationOsAlarmRef=Os/Rte_Al_TE_LOCK_LOCK_basic_Runnable, RteActivationOsTaskRef=OsTask_LOCK_100ms
  module config NvM
  module config Os
    OsTask_APP (OsTask):
      OsTaskActivation = 1
      OsTaskPriority = 15
      OsTaskSchedule = NON
      OsTaskEventRef = Rte_Ev_Cyclic_OsTask_APP_0_50ms
      OsTaskEventRef = Rte_Ev_Run_Cdd_SBC_UJA1169_Sbc_Test_Runnable
      OsTaskEventRef = Rte_Ev_Run_CpLedTask_LedRunnable
    3 x OsAlarm, all with OsAlarmCounterRef=SystemTimer:
      Rte_Al_TE_Cdd_SBC_UJA1169_Sbc_Test_Runnable
        OsAlarmAction
          OsAlarmSetEvent: OsAlarmSetEventRef=Rte_Ev_Run_Cdd_SBC_UJA1169_Sbc_Test_Runnable, OsAlarmSetEventTaskRef=OsTask_APP
      Rte_Al_TE_CpLedTask_LedRunnable
        OsAlarmAction
          OsAlarmSetEvent: OsAlarmSetEventRef=Rte_Ev_Run_CpLedTask_LedRunnable, OsAlarmSetEventTaskRef=OsTask_APP
      Rte_Al_TE_OsTask_APP_0_50ms
        OsAlarmAction
          OsAlarmSetEvent: OsAlarmSetEventRef=Rte_Ev_Cyclic_OsTask_APP_0_50ms, OsAlarmSetEventTaskRef=OsTask_APP
    OsTask_BSW_SCHM (OsTask):
      OsTaskActivation = 1
      OsTaskPriority = 10
      OsTaskSchedule = NON
      OsTaskEventRef = Rte_Ev_Cyclic2_OsTask_BSW_SCHM_0_10ms
      OsTaskEventRef = Rte_Ev_Cyclic2_OsTask_BSW_SCHM_0_20ms
      OsTaskEventRef = Rte_Ev_Run_CanTp_CanTp_MainFunction
    3 x OsAlarm, all with OsAlarmCounterRef=SystemTimer:
      Rte_Al_TE2_OsTask_BSW_SCHM_0_10ms
        OsAlarmAction
          OsAlarmSetEvent: OsAlarmSetEventRef=Rte_Ev_Cyclic2_OsTask_BSW_SCHM_0_10ms, OsAlarmSetEventTaskRef=OsTask_BSW_SCHM
      Rte_Al_TE2_OsTask_BSW_SCHM_0_20ms
        OsAlarmAction
          OsAlarmSetEvent: OsAlarmSetEventRef=Rte_Ev_Cyclic2_OsTask_BSW_SCHM_0_20ms, OsAlarmSetEventTaskRef=OsTask_BSW_SCHM
      Rte_Al_TE_CanTp_CanTp_MainFunction
        OsAlarmAction
          OsAlarmSetEvent: OsAlarmSetEventRef=Rte_Ev_Run_CanTp_CanTp_MainFunction, OsAlarmSetEventTaskRef=OsTask_BSW_SCHM
    OsTask_CPULoad_1S (OsTask): OsTaskActivation=3, OsTaskPriority=20, OsTaskSchedule=FULL
    Rte_Al_TE_CPULoad_CPUload_basic_Runnable_1S (OsAlarm): OsAlarmCounterRef=SystemTimer
      OsAlarmAction
        OsAlarmActivateTask: OsAlarmActivateTaskRef=OsTask_CPULoad_1S
    OsTask_EMC_PWL_CCC (OsTask):
      OsTaskActivation = 1
      OsTaskPriority = 20
      OsTaskSchedule = FULL
      OsTaskEventRef = Rte_Ev_Run_CCC_CCC_expand_Runnable_2S
      OsTaskEventRef = Rte_Ev_Run_EMC_EMC_expand_Runnable_10ms
      OsTaskEventRef = Rte_Ev_Run_PWL_PWL_expand_Runnable_20ms
    3 x OsAlarm, all with OsAlarmCounterRef=SystemTimer:
      Rte_Al_TE_CCC_CCC_expand_Runnable_2S
        OsAlarmAction
          OsAlarmSetEvent: OsAlarmSetEventRef=Rte_Ev_Run_CCC_CCC_expand_Runnable_2S, OsAlarmSetEventTaskRef=OsTask_EMC_PWL_CCC
      Rte_Al_TE_EMC_EMC_expand_Runnable_10ms
        OsAlarmAction
          OsAlarmSetEvent: OsAlarmSetEventRef=Rte_Ev_Run_EMC_EMC_expand_Runnable_10ms, OsAlarmSetEventTaskRef=OsTask_EMC_PWL_CCC
      Rte_Al_TE_PWL_PWL_expand_Runnable_20ms
        OsAlarmAction
          OsAlarmSetEvent: OsAlarmSetEventRef=Rte_Ev_Run_PWL_PWL_expand_Runnable_20ms, OsAlarmSetEventTaskRef=OsTask_EMC_PWL_CCC
    OsTask_LOCK_100ms (OsTask): OsTaskActivation=3, OsTaskPriority=25, OsTaskSchedule=FULL
    Rte_Al_TE_LOCK_LOCK_basic_Runnable (OsAlarm): OsAlarmCounterRef=SystemTimer
      OsAlarmAction
        OsAlarmActivateTask: OsAlarmActivateTaskRef=OsTask_LOCK_100ms
    9 x OsEvent:
      Rte_Ev_Cyclic2_OsTask_BSW_SCHM_0_10ms
      Rte_Ev_Cyclic2_OsTask_BSW_SCHM_0_20ms
      Rte_Ev_Cyclic_OsTask_APP_0_50ms
      Rte_Ev_Run_CCC_CCC_expand_Runnable_2S
      Rte_Ev_Run_CanTp_CanTp_MainFunction
      Rte_Ev_Run_Cdd_SBC_UJA1169_Sbc_Test_Runnable
      Rte_Ev_Run_CpLedTask_LedRunnable
      Rte_Ev_Run_EMC_EMC_expand_Runnable_10ms
      Rte_Ev_Run_PWL_PWL_expand_Runnable_20ms
  module config EcuC
  ecuc value collection DaVinci_Project: ecuc-values=[Com, Rte, Os, EcuC, NvM]
