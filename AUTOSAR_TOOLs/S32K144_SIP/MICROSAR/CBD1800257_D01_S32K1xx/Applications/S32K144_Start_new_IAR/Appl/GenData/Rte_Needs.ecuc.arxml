AUTOSAR XML (schema 4-0-3)
package /DaVinci_Project
  module config Com
    ComConfig
      5 x ComSignal:
        lwt_sig_recv2_RearLeftWinPos_olwt_msg_recv2_oCAN00_1d859839_Rx: ComSignalType=UINT8
        lwt_sig_recv2_RearRightWinPos_olwt_msg_recv2_oCAN00_b5508b86_Rx: ComSignalType=UINT8
        lwt_sig_trans2_FrongLight_olwt_msg_transmit2_oCAN00_65e2995e_Tx: ComSignalType=BOOLEAN
        sig_LampCnt_omsg_MyECU_Lamp_oCAN00_f37e68ea_Tx: ComSignalType=UINT8
        sig_RearInteriorLight_omsg_Transmit_oCAN00_49a633c1_Tx: ComSignalType=BOOLEAN
  module config Rte
    19 x RteBswModuleInstance:
      Adc
      BswM
        BswM_MainFunctionTimingEvent0 (RteBswEventToTaskMapping): RteBswUsedOsEventRef=Rte_Ev_Cyclic2_OsTask_BSW_SCHM_0_10ms, RteBswUsedOsAlarmRef=Os/Rte_Al_TE2_OsTask_BSW_SCHM_0_10ms
      Can
        3 x RteBswEventToTaskMapping, all with RteBswUsedOsEventRef=Rte_Ev_Cyclic2_OsTask_BSW_SCHM_0_10ms, RteBswUsedOsAlarmRef=Os/Rte_Al_TE2_OsTask_BSW_SCHM_0_10ms:
          Can_MainFunction_BusOffTimingEvent0
          Can_MainFunction_ModeTimingEvent0
          Can_MainFunction_WakeupTimingEvent0
      CanIf
      CanSM
        CanSM_MainFunctionTimingEvent0 (RteBswEventToTaskMapping): RteBswUsedOsEventRef=Rte_Ev_Cyclic2_OsTask_BSW_SCHM_0_10ms, RteBswUsedOsAlarmRef=Os/Rte_Al_TE2_OsTask_BSW_SCHM_0_10ms
      CanTp
        CanTp_MainFunctionTimingEvent0 (RteBswEventToTaskMapping): RteBswUsedOsEventRef=Rte_Ev_Run_CanTp_CanTp_MainFunction, RteBswUsedOsAlarmRef=Os/Rte_Al_TE_CanTp_CanTp_MainFunction
      Com
        Com_MainFunctionRxTimingEvent0 (RteBswEventToTaskMapping): RteBswUsedOsEventRef=Rte_Ev_Cyclic2_OsTask_BSW_SCHM_0_10ms, RteBswUsedOsAlarmRef=Os/Rte_Al_TE2_OsTask_BSW_SCHM_0_10ms
        Com_MainFunctionTxTimingEvent0 (RteBswEventToTaskMapping): RteBswUsedOsEventRef=Rte_Ev_Cyclic2_OsTask_BSW_SCHM_0_10ms, RteBswUsedOsAlarmRef=Os/Rte_Al_TE2_OsTask_BSW_SCHM_0_10ms
      ComM
        ComM_MainFunction_0TimingEvent0 (RteBswEventToTaskMapping): RteBswUsedOsEventRef=Rte_Ev_Cyclic2_OsTask_BSW_SCHM_0_20ms, RteBswUsedOsAlarmRef=Os/Rte_Al_TE2_OsTask_BSW_SCHM_0_20ms
      Dcm
        Dcm_MainFunctionTimingEvent0 (RteBswEventToTaskMapping): RteBswUsedOsEventRef=Rte_Ev_Cyclic2_OsTask_BSW_SCHM_0_10ms, RteBswUsedOsAlarmRef=Os/Rte_Al_TE2_OsTask_BSW_SCHM_0_10ms
      Dem
        Dem_MasterMainFunctionTimingEvent0 (RteBswEventToTaskMapping): RteBswUsedOsEventRef=Rte_Ev_Cyclic2_OsTask_BSW_SCHM_0_10ms, RteBswUsedOsAlarmRef=Os/Rte_Al_TE2_OsTask_BSW_SCHM_0_10ms
        Dem_SatelliteMainFunctionTimingEvent0 (RteBswEventToTaskMapping): RteBswUsedOsEventRef=Rte_Ev_Cyclic2_OsTask_BSW_SCHM_0_10ms, RteBswUsedOsAlarmRef=Os/Rte_Al_TE2_OsTask_BSW_SCHM_0_10ms
      Det
      Dio
      EcuM
        EcuM_MainFunctionTimingEvent0 (RteBswEventToTaskMapping): RteBswUsedOsEventRef=Rte_Ev_Cyclic2_OsTask_BSW_SCHM_0_10ms, RteBswUsedOsAlarmRef=Os/Rte_Al_TE2_OsTask_BSW_SCHM_0_10ms
      Gpt
      Mcu
      PduR
      Port
      Pwm
      Spi
        Spi_MainFunction_HandlingTimingEvent0 (RteBswEventToTaskMapping)
    12 x RteSwComponentInstance:
      BswM_EcuSwComposition
        Timer_BswM_MainFunction (RteEventToTaskMapping): RteUsedOsEventRef=Rte_Ev_Cyclic2_OsTask_BSW_SCHM_0_10ms, RteUsedOsAlarmRef=Os/Rte_Al_TE2_OsTask_BSW_SCHM_0_10ms
      Cdd_SBC_UJA1169_EcuSwComposition
        TMT_Sbc_Test_Runnable (RteEventToTaskMapping): RteUsedOsEventRef=Rte_Ev_Run_Cdd_SBC_UJA1169_Sbc_Test_Runnable, RteUsedOsAlarmRef=Os/Rte_Al_TE_Cdd_SBC_UJA1169_Sbc_Test_Runnable
      ComM_EcuSwComposition
        Timer_ComM_MainFunction_0 (RteEventToTaskMapping): RteUsedOsEventRef=Rte_Ev_Cyclic2_OsTask_BSW_SCHM_0_20ms, RteUsedOsAlarmRef=Os/Rte_Al_TE2_OsTask_BSW_SCHM_0_20ms
      CpLedTask_EcuSwComposition
        TMT_LedRunnable (RteEventToTaskMapping): RteUsedOsEventRef=Rte_Ev_Run_CpLedTask_LedRunnable, RteUsedOsAlarmRef=Os/Rte_Al_TE_CpLedTask_LedRunnable
      Dcm_EcuSwComposition
        Timer_Dcm_MainFunction (RteEventToTaskMapping): RteUsedOsEventRef=Rte_Ev_Cyclic2_OsTask_BSW_SCHM_0_10ms, RteUsedOsAlarmRef=Os/Rte_Al_TE2_OsTask_BSW_SCHM_0_10ms
      DemMaster_0_EcuSwComposition
        Timer_Dem_MasterMainFunction (RteEventToTaskMapping): RteUsedOsEventRef=Rte_Ev_Cyclic2_OsTask_BSW_SCHM_0_10ms, RteUsedOsAlarmRef=Os/Rte_Al_TE2_OsTask_BSW_SCHM_0_10ms
      DemSatellite_0_EcuSwComposition
        Timer_Dem_SatelliteMainFunction (RteEventToTaskMapping): RteUsedOsEventRef=Rte_Ev_Cyclic2_OsTask_BSW_SCHM_0_10ms, RteUsedOsAlarmRef=Os/Rte_Al_TE2_OsTask_BSW_SCHM_0_10ms
      Det_EcuSwComposition
      EcuM_EcuSwComposition
        Timer_EcuM_MainFunction (RteEventToTaskMapping): RteUsedOsEventRef=Rte_Ev_Cyclic2_OsTask_BSW_SCHM_0_10ms, RteUsedOsAlarmRef=Os/Rte_Al_TE2_OsTask_BSW_SCHM_0_10ms
      Os_OsCore0_swc_EcuSwComposition
      Test2_SWC_EcuSwComposition
        TMT_Test_SWC2_Main (RteEventToTaskMapping): RteUsedOsEventRef=Rte_Ev_Cyclic_OsTask_APP_0_50ms, RteUsedOsAlarmRef=Os/Rte_Al_TE_OsTask_APP_0_50ms
      Test_SWC_EcuSwComposition
        TMT_Test_SWC_Main (RteEventToTaskMapping): RteUsedOsEventRef=Rte_Ev_Cyclic_OsTask_APP_0_50ms, RteUsedOsAlarmRef=Os/Rte_Al_TE_OsTask_APP_0_50ms
    RteOsInteraction
      6 x RteUsedOsActivation, all with RteExpectedActivationOffset=0:
        Rte_Al_TE_Cdd_SBC_UJA1169_Sbc_Test_Runnable: RteActivationOsAlarmRef=Os/Rte_Al_TE_Cdd_SBC_UJA1169_Sbc_Test_Runnable, RteActivationOsTaskRef=OsTask_APP
        Rte_Al_TE_CpLedTask_LedRunnable: RteActivationOsAlarmRef=Os/Rte_Al_TE_CpLedTask_LedRunnable, RteActivationOsTaskRef=OsTask_APP
        Rte_Al_TE_OsTask_APP_0_50ms: RteActivationOsAlarmRef=Os/Rte_Al_TE_OsTask_APP_0_50ms, RteActivationOsTaskRef=OsTask_APP
        Rte_Al_TE2_OsTask_BSW_SCHM_0_10ms: RteActivationOsAlarmRef=Os/Rte_Al_TE2_OsTask_BSW_SCHM_0_10ms, RteActivationOsTaskRef=OsTask_BSW_SCHM
        Rte_Al_TE2_OsTask_BSW_SCHM_0_20ms: RteActivationOsAlarmRef=Os/Rte_Al_TE2_OsTask_BSW_SCHM_0_20ms, RteActivationOsTaskRef=OsTask_BSW_SCHM
        Rte_Al_TE_CanTp_CanTp_MainFunction: RteActivationOsAlarmRef=Os/Rte_Al_TE_CanTp_CanTp_MainFunction, RteActivationOsTaskRef=OsTask_BSW_SCHM
  module config NvM
  module config Os
    OsTask_APP (OsTask):
      OsTaskActivation = 1
      OsTaskPriority = 15
      OsTaskSchedule = NON
      OsTaskEventRef = Rte_Ev_Cyclic_OsTask_APP_0_50ms
      OsTaskEventRef = Rte_Ev_Run_Cdd_SBC_UJA1169_Sbc_Test_Runnable
      OsTaskEventRef = Rte_Ev_Run_CpLedTask_LedRunnable
    3 x OsAlarm, all with OsAlarmCounterRef=SystemTimer:
      Rte_Al_TE_Cdd_SBC_UJA1169_Sbc_Test_Runnable
        OsAlarmAction
          OsAlarmSetEvent: OsAlarmSetEventRef=Rte_Ev_Run_Cdd_SBC_UJA1169_Sbc_Test_Runnable, OsAlarmSetEventTaskRef=OsTask_APP
      Rte_Al_TE_CpLedTask_LedRunnable
        OsAlarmAction
          OsAlarmSetEvent: OsAlarmSetEventRef=Rte_Ev_Run_CpLedTask_LedRunnable, OsAlarmSetEventTaskRef=OsTask_APP
      Rte_Al_TE_OsTask_APP_0_50ms
        OsAlarmAction
          OsAlarmSetEvent: OsAlarmSetEventRef=Rte_Ev_Cyclic_OsTask_APP_0_50ms, OsAlarmSetEventTaskRef=OsTask_APP
    OsTask_BSW_SCHM (OsTask):
      OsTaskActivation = 1
      OsTaskPriority = 10
      OsTaskSchedule = NON
      OsTaskEventRef = Rte_Ev_Cyclic2_OsTask_BSW_SCHM_0_10ms
      OsTaskEventRef = Rte_Ev_Cyclic2_OsTask_BSW_SCHM_0_20ms
      OsTaskEventRef = Rte_Ev_Run_CanTp_CanTp_MainFunction
    3 x OsAlarm, all with OsAlarmCounterRef=SystemTimer:
      Rte_Al_TE2_OsTask_BSW_SCHM_0_10ms
        OsAlarmAction
          OsAlarmSetEvent: OsAlarmSetEventRef=Rte_Ev_Cyclic2_OsTask_BSW_SCHM_0_10ms, OsAlarmSetEventTaskRef=OsTask_BSW_SCHM
      Rte_Al_TE2_OsTask_BSW_SCHM_0_20ms
        OsAlarmAction
          OsAlarmSetEvent: OsAlarmSetEventRef=Rte_Ev_Cyclic2_OsTask_BSW_SCHM_0_20ms, OsAlarmSetEventTaskRef=OsTask_BSW_SCHM
      Rte_Al_TE_CanTp_CanTp_MainFunction
        OsAlarmAction
          OsAlarmSetEvent: OsAlarmSetEventRef=Rte_Ev_Run_CanTp_CanTp_MainFunction, OsAlarmSetEventTaskRef=OsTask_BSW_SCHM
    6 x OsEvent:
      Rte_Ev_Cyclic2_OsTask_BSW_SCHM_0_10ms
      Rte_Ev_Cyclic2_OsTask_BSW_SCHM_0_20ms
      Rte_Ev_Cyclic_OsTask_APP_0_50ms
      Rte_Ev_Run_CanTp_CanTp_MainFunction
      Rte_Ev_Run_Cdd_SBC_UJA1169_Sbc_Test_Runnable
      Rte_Ev_Run_CpLedTask_LedRunnable
  module config EcuC
  ecuc value collection DaVinci_Project: ecuc-values=[Com, Rte, Os, EcuC, NvM]
