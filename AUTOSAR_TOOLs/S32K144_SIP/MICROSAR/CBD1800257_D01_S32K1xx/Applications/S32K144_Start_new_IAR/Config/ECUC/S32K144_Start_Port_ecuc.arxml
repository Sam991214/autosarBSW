AUTOSAR XML (schema 4-2-1)
package /Port
  module config Port: implementation-config-variant=VARIANT-POST-BUILD, module-description=Port_Impl
    CommonPublishedInformation:
      ArReleaseMajorVersion = 4
      ArReleaseMinorVersion = 2
      ArReleaseRevisionVersion = 2
      ModuleId = 124
      SwMajorVersion = 1
      SwMinorVersion = 0
      SwPatchVersion = 1
      VendorId = 43
    PortConfigSet
      NotUsedPortPin: PortPinDSE=Low_Drive_Strength, PortPinDirection=PORT_PIN_IN, PortPinLevelValue=PORT_PIN_LEVEL_LOW, PortPinPE=PullDisabled, PortPinPS=PullDown
      5 x PortContainer:
        PortContainer_0: PortNumberOfPortPins=5
          5 x PortPin, all with PortPinDSE=Low_drive_strength, PortPinDirectionChangeable=true, PortPinInitialMode=PORT_GPIO_MODE, PortPinLevelValue=PORT_PIN_LEVEL_LOW, PortPinModeChangeable=true, PortPinPE=PullDisabled, PortPinPFE=false, PortPinPS=PullDown:
            PortPin_PTC4_JATG_TCK_SWD_CLK: PortPinDirection=PORT_PIN_IN, PortPinId=4, PortPinMode=JTAG_TCLK_SWD_CLK, PortPinPcr=68
            PortPin_PTD16: PortPinDirection=PORT_PIN_OUT, PortPinId=1, PortPinMode=GPIO, PortPinPcr=112
            PortPin_PTC5_JTAG_TDI: PortPinDirection=PORT_PIN_IN, PortPinId=5, PortPinMode=JTAG_TDI, PortPinPcr=69
            PortPin_PTA10_JTAG_TDO: PortPinDirection=PORT_PIN_OUT, PortPinId=3, PortPinMode=JTAG_TDO, PortPinPcr=10
            PortPin_PTA4_JTAG_TMS_SWD_DIO: PortPinDirection=PORT_PIN_OUT, PortPinId=2, PortPinMode=JTAG_TMS_SWD_DIO, PortPinPcr=4
        PortContainer_CAN: PortNumberOfPortPins=2
          PortPin_PTE4_CAN0_RX (PortPin):
            PortPinDSE = Low_drive_strength
            PortPinDirection = PORT_PIN_IN
            PortPinDirectionChangeable = true
            PortPinId = 7
            PortPinInitialMode = PORT_GPIO_MODE
            PortPinLevelValue = PORT_PIN_LEVEL_LOW
            PortPinMode = CAN0_RX
            PortPinModeChangeable = true
            PortPinPE = PullDisabled
            PortPinPFE = false
            PortPinPS = PullDown
            PortPinPcr = 132
          PortPin_PTE5_CAN0_TX (PortPin):
            PortPinDSE = Low_drive_strength
            PortPinDirection = PORT_PIN_OUT
            PortPinDirectionChangeable = true
            PortPinId = 6
            PortPinInitialMode = PORT_GPIO_MODE
            PortPinLevelValue = PORT_PIN_LEVEL_LOW
            PortPinMode = CAN0_TX
            PortPinModeChangeable = true
            PortPinPE = PullDisabled
            PortPinPFE = false
            PortPinPS = PullDown
            PortPinPcr = 133
        PortContainer_SBC_SPI: PortNumberOfPortPins=4
          4 x PortPin, all with PortPinDSE=Low_drive_strength, PortPinDirectionChangeable=true, PortPinInitialMode=PORT_GPIO_MODE, PortPinLevelValue=PORT_PIN_LEVEL_LOW, PortPinModeChangeable=true, PortPinPE=PullDisabled, PortPinPFE=false, PortPinPS=PullDown:
            PortPin_PTB14_SCK: PortPinDirection=PORT_PIN_OUT, PortPinId=8, PortPinMode=LPSPI1_SCK, PortPinPcr=46
            PortPin_PTB15_MISO: PortPinDirection=PORT_PIN_IN, PortPinId=9, PortPinMode=LPSPI1_SIN, PortPinPcr=47
            PortPin_PTB16_MOSI: PortPinDirection=PORT_PIN_OUT, PortPinId=10, PortPinMode=LPSPI1_SOUT, PortPinPcr=48
            PortPin_PTB17_PCS: PortPinDirection=PORT_PIN_OUT, PortPinId=11, PortPinMode=LPSPI1_PCS3, PortPinPcr=49
        PortContainer_switch_lwt: PortNumberOfPortPins=1
          PortPin_ptc12_lwt (PortPin):
            PortPinPFE = false
            PortPinDirectionChangeable = true
            PortPinModeChangeable = true
            PortPinId = 12
            PortPinPcr = 76
            PortPinMode = GPIO
            PortPinDSE = Low_drive_strength
            PortPinPE = PullDisabled
            PortPinPS = PullDown
            PortPinDirection = PORT_PIN_IN
            PortPinInitialMode = PORT_GPIO_MODE
            PortPinLevelValue = PORT_PIN_LEVEL_LOW
        PortContainer_sled_lwt: PortNumberOfPortPins=2
          PortPin_ptd0_lwt (PortPin):
            PortPinPFE = false
            PortPinDirectionChangeable = true
            PortPinModeChangeable = true
            PortPinId = 13
            PortPinPcr = 96
            PortPinMode = GPIO
            PortPinDSE = Low_drive_strength
            PortPinPE = PullDisabled
            PortPinPS = PullDown
            PortPinDirection = PORT_PIN_OUT
            PortPinInitialMode = PORT_GPIO_MODE
            PortPinLevelValue = PORT_PIN_LEVEL_HIGH
          PortPin_ptd15_lwt (PortPin):
            PortPinPFE = false
            PortPinDirectionChangeable = true
            PortPinModeChangeable = true
            PortPinId = 14
            PortPinPcr = 111
            PortPinMode = FTM0_CH0
            PortPinDSE = Low_drive_strength
            PortPinPE = PullDisabled
            PortPinPS = PullDown
            PortPinDirection = PORT_PIN_OUT
            PortPinInitialMode = PORT_GPIO_MODE
            PortPinLevelValue = PORT_PIN_LEVEL_HIGH
    PortGeneral:
      PortDevErrorDetect = true
      PortEnableUserModeSupport = false
      PortSet2PinsDirectionApi = false
      PortSetPinDirectionApi = true
      PortSetPinModeApi = true
      PortSetPinModeDoesNotTouchGpioLevel = false
      PortVersionInfoApi = true
