AUTOSAR XML (schema 4-2-1)
package /ActiveEcuC
  module config Com: implementation-config-variant=VARIANT-PRE-COMPILE, module-description=Com_Impl
    ComGeneration:
      ComOutOfBoundsWriteProtectionStrategy = NONE
      ComOutOfBoundsWriteSanitizer = false
      ComOutOfBoundsReadSanitizer = false
      ComReduceConstantData2Define = false
      ComBoolDataInArrayOfStructStrategy = BOOLEAN
      ComDeduplicateIndirectedData = true
      ComDataDeduplicationStrategy = WITH_CAST
      ComReduceBoolDataByNegationThreshold = 2
      ComReduceBoolDataByNumericalComparisonThreshold = 2
      ComReduceBoolDataByNumericalRelationThreshold = 2
      ComReduceBoolDataByNumericalOperandStrategy = WITH_ANY_VALUE
      ComReduceNumericalDataByOffsetThreshold = 2
      ComReduceNumericalDataByArraySubtractionThreshold = 2
      ComReduceDataByStreaming = false
      ComShortSymbols = false
      ComInterfacesForDeactivatedData = false
      ComReferringKeysInComments = false
    ComOptimization:
      ComTxCyclicProcessingISRLockThreshold = 1
      ComTxDeadlineMonitoringISRLockThreshold = 1
      ComTxProcessingISRLockThreshold = 1
      ComRxDeadlineMonitoringISRLockThreshold = 1
      ComRxDeferredProcessingISRLockThreshold = 1
      ComGatewayProcessingISRLockThreshold = 1
      ComGatewayDescriptionProcessingISRLockThreshold = 1
      ComIPduGroupISRLockThreshold = 1
    ComConfig: ComConfigurationId=0, ComRxDeferredNotificationCacheSize=1, ComRxImmediateNotificationCacheSize=0
      MyECU_oCAN00_Rx_4cbf71f7 (ComIPduGroup): ComIPduGroupHandleId=0
      sig_State_RearLeftDoor_omsg_Receive_oCAN00_84ad4140_Rx (ComSignal):
        ComBitPosition = 0
        ComBitSize = 1
        ComSignalEndianness = LITTLE_ENDIAN
        ComSignalInitValue = 0
        ComSignalType = BOOLEAN
        ComTimeout = 0
        ComSignalAccess = ACCESS_UNCLEAR
        ComHandleId = 3
        ComSystemTemplateSystemSignalRef = sig_State_RearLeftDoor
      sig_LampCnt_omsg_MyECU_Lamp_oCAN00_f37e68ea_Tx (ComSignal):
        ComBitPosition = 7
        ComBitSize = 8
        ComSignalEndianness = BIG_ENDIAN
        ComSignalInitValue = 0
        ComSignalType = UINT8
        ComTransferProperty = PENDING
        ComSignalAccess = ACCESS_UNCLEAR
        ComHandleId = 5
        ComSystemTemplateSystemSignalRef = sig_LampCnt
      ComTimeBase: ComRxTimeBase=0.01, ComTxTimeBase=0.01, ComGwTimeBase=0.01
      msg_Transmit_oCAN00_0723e95e_Tx (ComIPdu):
        ComIPduDirection = SEND
        ComIPduType = NORMAL
        ComIPduHandleId = 2
        ComIPduSignalProcessing = DEFERRED
        ComIPduCancellationSupport = false
        ComIPduGroupRef = MyECU_oCAN00_Tx_1ae5d671
        ComIPduSignalRef = sig_RearInteriorLight_omsg_Transmit_oCAN00_49a633c1_Tx
        ComPduIdRef = msg_Transmit_oCAN00_0723e95e_Tx
        ComIPduSignalGroupRef = lwt_ComSignalGroup
        ComTxIPdu: ComMinimumDelayTime=0, ComTxIPduUnusedAreasDefault=0
          ComTxModeTrue
            ComTxMode: ComTxModeMode=PERIODIC, ComTxModeTimeOffset=0, ComTxModeTimePeriod=0.1
          ComTxModeFalse
            ComTxMode: ComTxModeMode=PERIODIC, ComTxModeTimeOffset=0, ComTxModeTimePeriod=0.1
      sig_State_RearInteriorLight_omsg_Receive_oCAN00_63323183_Rx (ComSignal):
        ComBitPosition = 2
        ComBitSize = 1
        ComSignalEndianness = LITTLE_ENDIAN
        ComSignalInitValue = 0
        ComSignalType = BOOLEAN
        ComTimeout = 0
        ComSignalAccess = ACCESS_UNCLEAR
        ComHandleId = 2
        ComSystemTemplateSystemSignalRef = sig_State_RearInteriorLight
      sig_State_RearRightDoor_omsg_Receive_oCAN00_a8945098_Rx (ComSignal):
        ComBitPosition = 1
        ComBitSize = 1
        ComSignalEndianness = LITTLE_ENDIAN
        ComSignalInitValue = 0
        ComSignalType = BOOLEAN
        ComTimeout = 0
        ComSignalAccess = ACCESS_UNCLEAR
        ComHandleId = 4
        ComSystemTemplateSystemSignalRef = sig_State_RearRightDoor
      msg_Receive_oCAN00_2b456e3f_Rx (ComIPdu):
        ComIPduDirection = RECEIVE
        ComIPduType = NORMAL
        ComIPduHandleId = 1
        ComIPduSignalProcessing = DEFERRED
        ComIPduCancellationSupport = false
        ComIPduGroupRef = MyECU_oCAN00_Rx_4cbf71f7
        ComIPduSignalRef = sig_State_RearInteriorLight_omsg_Receive_oCAN00_63323183_Rx
        ComIPduSignalRef = sig_State_RearLeftDoor_omsg_Receive_oCAN00_84ad4140_Rx
        ComIPduSignalRef = sig_State_RearRightDoor_omsg_Receive_oCAN00_a8945098_Rx
        ComPduIdRef = msg_Receive_oCAN00_2b456e3f_Rx
      MyECU_oCAN00_Tx_1ae5d671 (ComIPduGroup): ComIPduGroupHandleId=1
      msg_MyECU_Lamp_oCAN00_818e1651_Tx (ComIPdu):
        ComIPduDirection = SEND
        ComIPduType = NORMAL
        ComIPduHandleId = 1
        ComIPduSignalProcessing = DEFERRED
        ComIPduCancellationSupport = false
        ComIPduGroupRef = MyECU_oCAN00_Tx_1ae5d671
        ComIPduSignalRef = sig_LampCnt_omsg_MyECU_Lamp_oCAN00_f37e68ea_Tx
        ComPduIdRef = msg_MyECU_Lamp_oCAN00_818e1651_Tx
        ComTxIPdu: ComMinimumDelayTime=0, ComTxIPduUnusedAreasDefault=0
          ComTxModeTrue
            ComTxMode: ComTxModeMode=PERIODIC, ComTxModeTimeOffset=0, ComTxModeTimePeriod=0.1
          ComTxModeFalse
            ComTxMode: ComTxModeMode=PERIODIC, ComTxModeTimeOffset=0, ComTxModeTimePeriod=0.1
      sig_RearInteriorLight_omsg_Transmit_oCAN00_49a633c1_Tx (ComSignal):
        ComBitPosition = 0
        ComBitSize = 1
        ComSignalEndianness = LITTLE_ENDIAN
        ComSignalInitValue = 0
        ComSignalType = BOOLEAN
        ComTransferProperty = PENDING
        ComSignalAccess = ACCESS_UNCLEAR
        ComHandleId = 6
        ComSystemTemplateSystemSignalRef = sig_RearInteriorLight
      RearLeft_window_LWT (ComSignal):
        ComBitPosition = 0
        ComSignalEndianness = LITTLE_ENDIAN
        ComSignalInitValue = 0
        ComSignalType = BOOLEAN
        ComSignalAccess = ACCESS_UNCLEAR
        ComHandleId = 0
        ComBitSize = 1
        ComTransferProperty = TRIGGERED
      myECU2_Com_CAN_Network (ComIPdu):
        ComIPduDirection = SEND
        ComIPduHandleId = 3
        ComIPduSignalProcessing = IMMEDIATE
        ComIPduType = NORMAL
        ComIPduCancellationSupport = false
        ComPduIdRef = myECU2_ipdu_comTopdur
        ComIPduGroupRef = MyECU_oCAN00_Tx_1ae5d671
        ComIPduSignalRef = RearLeft_window_LWT
        ComIPduSignalRef = RearRight_window_case1
        ComTxIPdu: ComMinimumDelayTime=0, ComTxIPduUnusedAreasDefault=0
          ComTxModeFalse
            ComTxMode: ComTxModeMode=NONE
          ComTxModeTrue
            ComTxMode: ComTxModeMode=DIRECT, ComTxModeTimePeriod=3, ComTxModeTimeOffset=0, ComTxModeNumberOfRepetitions=3, ComTxModeRepetitionPeriod=0.01
      3 x ComSignal, all with ComSignalEndianness=LITTLE_ENDIAN, ComSignalInitValue=0, ComSignalAccess=ACCESS_UNCLEAR:
        lwt_sig_recv2_RearRightWinPos_olwt_msg_recv2_oCAN00_b5508b86_Rx: ComBitPosition=8, ComBitSize=8, ComSignalType=UINT8, ComTimeout=0, ComHandleId=1, ComFirstTimeout=1, ComSystemTemplateSystemSignalRef=lwt_sig_recv2_RearRightWinPos
        lwt_sig_trans2_FrongLight_olwt_msg_transmit2_oCAN00_65e2995e_Tx: ComBitPosition=0, ComBitSize=1, ComSignalType=BOOLEAN, ComTransferProperty=PENDING, ComHandleId=4, ComSystemTemplateSystemSignalRef=lwt_sig_trans2_FrongLight
        lwt_sig_recv2_RearLeftWinPos_olwt_msg_recv2_oCAN00_1d859839_Rx: ComBitPosition=56, ComBitSize=8, ComSignalType=UINT8, ComTimeout=1, ComHandleId=0, ComFirstTimeout=1, ComNotification=lwt_rear_left_win_callback, ComRxDataTimeoutAction=REPLACE, ComRxDataTimeoutSubstitutionValue=10, ComTimeoutNotification=lwt_rear_left_win_timeout, ComSystemTemplateSystemSignalRef=lwt_sig_recv2_RearLeftWinPos
      lwt_msg_recv2_oCAN00_700d1e50_Rx (ComIPdu):
        ComIPduDirection = RECEIVE
        ComIPduType = NORMAL
        ComIPduHandleId = 0
        ComIPduSignalProcessing = DEFERRED
        ComIPduCancellationSupport = false
        ComIPduGroupRef = MyECU_oCAN00_Rx_4cbf71f7
        ComIPduSignalRef = lwt_sig_recv2_RearLeftWinPos_olwt_msg_recv2_oCAN00_1d859839_Rx
        ComIPduSignalRef = lwt_sig_recv2_RearRightWinPos_olwt_msg_recv2_oCAN00_b5508b86_Rx
        ComPduIdRef = lwt_msg_recv2_oCAN00_700d1e50_Rx
      lwt_msg_transmit2_oCAN00_06a375f9_Tx (ComIPdu):
        ComIPduDirection = SEND
        ComIPduType = NORMAL
        ComIPduHandleId = 0
        ComIPduSignalProcessing = DEFERRED
        ComIPduCancellationSupport = false
        ComIPduGroupRef = MyECU_oCAN00_Tx_1ae5d671
        ComIPduSignalRef = lwt_sig_trans2_FrongLight_olwt_msg_transmit2_oCAN00_65e2995e_Tx
        ComPduIdRef = lwt_msg_transmit2_oCAN00_06a375f9_Tx
        ComTxIPdu: ComMinimumDelayTime=0, ComTxIPduUnusedAreasDefault=0
          ComTxModeTrue
            ComTxMode: ComTxModeMode=PERIODIC, ComTxModeTimeOffset=0, ComTxModeTimePeriod=0.1
          ComTxModeFalse
            ComTxMode: ComTxModeMode=NONE, ComTxModeTimePeriod=0.1
      RearRight_window_case1 (ComSignal):
        ComBitPosition = 1
        ComSignalEndianness = LITTLE_ENDIAN
        ComSignalInitValue = 0
        ComSignalType = BOOLEAN
        ComSignalAccess = ACCESS_UNCLEAR
        ComHandleId = 1
        ComBitSize = 1
        ComTransferProperty = PENDING
      lwt_ComSignalGroup (ComSignalGroup): ComSignalGroupAccess=ACCESS_NEEDED_BY_SWC_OR_COM, ComHandleId=0, ComTransferProperty=TRIGGERED
        lwt_sig_group_001 (ComGroupSignal):
          ComBitPosition = 32
          ComSignalEndianness = LITTLE_ENDIAN
          ComSignalInitValue = 0
          ComSignalType = UINT16
          ComSignalAccess = ACCESS_UNCLEAR
          ComHandleId = 3
          ComBitSize = 16
          ComTransferProperty = PENDING
        lwt_sig_group_000 (ComGroupSignal):
          ComBitPosition = 8
          ComSignalEndianness = LITTLE_ENDIAN
          ComSignalInitValue = 0
          ComSignalType = UINT16
          ComSignalAccess = ACCESS_UNCLEAR
          ComHandleId = 2
          ComBitSize = 16
          ComTransferProperty = PENDING
    ComGeneral:
      ComConfigurationUseDet = true
      ComEnableSignalGroupArrayApi = false
      ComRetryFailedTransmitRequests = false
      ComSupportedIPduGroups = 2
      ComVersionInfoApi = false
      ComAdvancedIPduCallouts = true
      ComOptimizedIPduGroupHandling = false
      ComMetaDataSupport = false
      ComReceiveSignalMacroAPI = false
      ComDeferredEventCacheSupport = false
      ComMainfunctionTimingDomainSupport = false
      ComDescriptionRoutingCodeGeneration = false
      ComSafeBswChecks = false
      ComUserCbkHeaderFile = Appl_Cbk.h
