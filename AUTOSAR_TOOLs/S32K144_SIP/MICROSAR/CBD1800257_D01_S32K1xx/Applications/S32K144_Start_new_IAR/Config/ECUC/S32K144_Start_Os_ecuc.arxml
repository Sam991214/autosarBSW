AUTOSAR XML (schema 4-2-1)
package /ActiveEcuC
  module config Os: implementation-config-variant=VARIANT-PRE-COMPILE, module-description=Os_Impl
    OsPublishedInformation: OsKernelVersion=7, OsPlatformName=Arm
      S32K148 (OsDerivativeInformation):
        OsMpuAlignment = 32
        OsStackAlignment = 32
        OsExceptionVectorTableAlignment = 0
        OsInterruptVectorTableAlignment = 128
        OsHardwareManuals = NXP/Freescale - S32K14x Series Reference Manual - Supports S32K142, S32K144, S32K146, and S32K148 Document Number: S32K14XRM - Rev. 3, 03/2017
        INTC (OsSystemIntCtrl):
          OsSystemIntCtrlMaxPrios = 224
          OsSystemIntCtrlMaxSources = 240
          OsSystemIntCtrlPrioOrder = DESC
          OsSystemIntCtrlBaseAddress = 3758153728
          OsSystemIntCtrlType = NVIC
        Core0 (OsPhysicalCore):
          OsPhysicalCoreId = 0
          OsPhysicalCoreExceptionSources = 8
          OsPhysicalCoreIsAutostart = true
          OsPhysicalCoreMasterStartAllowed = false
          OsPhysicalCorePrivelegedHwAccess = true
          OsPhysicalCoreType = Cortex-M
          OsPhysicalCoreDefaultEntrySymbol = _start
          OsPhysicalCoreStackProtectionUnit = SystemMPU0
        SystemMPU0 (OsSystemMpu): OsSystemMpuBaseAddress=1073795072, OsSystemMpuId=0, OsSystemMpuMaxRegions=16, OsSystemMpuType=SYSTEM_MPU_NXP
        OsMemoryRegionDefaults_AppT (OsMemoryRegionDefaults): OsMemoryRegionDefType=APPLICATION_TRUSTED, OsMemoryRegionDefAccessRights=SUPERVISOR_RWX, OsMemoryRegionDefBusMasters=Core
        OsMemoryRegionDefaults_AppNT (OsMemoryRegionDefaults):
          OsMemoryRegionDefType = APPLICATION_NONTRUSTED
          OsMemoryRegionDefBusMasters = Core
          OsMemoryRegionDefAccessRights = USER_R
          OsMemoryRegionDefAccessRights = USER_W
        OsMemoryRegionSpecifics
          4 x OsMemoryRegionAccess:
            USER_X: OsMemoryRegionAccessRights=X, OsMemoryRegionAccessType=USER
            USER_W: OsMemoryRegionAccessRights=W, OsMemoryRegionAccessType=USER
            SUPERVISOR_RX: OsMemoryRegionAccessRights=RX, OsMemoryRegionAccessType=SUPERVISOR
            SUPERVISOR_RW: OsMemoryRegionAccessRights=RW, OsMemoryRegionAccessType=SUPERVISOR
          Debugger (OsMemoryRegionBusMaster): OsMemoryRegionBusMasterId=1
          PID_ENABLE (OsMemoryRegionFlag)
          SUPERVISOR_RWX (OsMemoryRegionAccess): OsMemoryRegionAccessRights=RWX, OsMemoryRegionAccessType=SUPERVISOR
          3 x OsMemoryRegionBusMaster:
            DMA: OsMemoryRegionBusMasterId=2
            Core: OsMemoryRegionBusMasterId=0
            ENET: OsMemoryRegionBusMasterId=3
          USER_R (OsMemoryRegionAccess): OsMemoryRegionAccessRights=R, OsMemoryRegionAccessType=USER
        SysTick (OsHardwareTimer): OsHardwareTimerBaseAddress=3758153744, OsHardwareTimerId=0, OsHardwareTimerSize=24, OsHardwareTimerUnit=PIT, OsHardwareTimerType=SysTick
          SysTick_Ch0 (OsHardwareTimerChannel): OsHardwareTimerChannelId=0, OsHardwareTimerChannelIntSource=15, OsHardwareTimerChannelOffset=0
        DEFAULT (OsInterruptSupportedType): OsInterruptSupportedTypeSeparateSources=false
    OS_APPMODE_ANY (OsAppMode)
    OSDEFAULTAPPMODE (OsAppMode)
    OsOS:
      OsGenerateMemMapForNearAddressing = false
      OsStackMonitoring = true
      OsStatus = EXTENDED
      OsUseGetServiceId = false
      OsUseParameterAccess = false
      OsUseResScheduler = false
      OsForcibleTermination = false
      OsGenerateCalloutStubs = true
      OsGenerateMemMap = COMPLETE
      OsGenerateMemMapForThreads = false
      OsServiceProtection = false
      OsStackUsageMeasurement = false
      OsUseXSignalAsyncApiCalls = false
      OsFpuUsage = NONE
      OsScalabilityClass = SC1
      OsNumberOfCores = 1
      OsMasterCore = OsCore0
      OsSystemTimer = SystemTimer
      OsStackSummary
        11 x OsStack, all with OsStackCore=OsCore0:
          OsCore0_Error: OsStackSize=1024, OsStackType=CORE_ERROR_STACK, OsStackUser=OsCore0
          OsCore0_Init: OsStackSize=2048, OsStackType=CORE_INIT_STACK, OsStackUser=OsCore0
          OsCore0_Kernel: OsStackSize=2048, OsStackType=CORE_KERNEL_STACK, OsStackUser=OsCore0
          OsCore0_Isr_Core: OsStackSize=1024, OsStackType=ISR_SHARED_CORE_STACK, OsStackUser=CanIsr_0_MB16To31, OsStackUser=CanIsr_0_BusOff, OsStackUser=CanIsr_0_MB00To15, OsStackUser=CounterIsr_SystemTimer, OsStackUser=Adc_ConvertGroup0_lwt, OsStackUser=Gptlsr_LpitChannel0
          OsCore0_Task_Prio4294967295: OsStackSize=1024, OsStackType=TASK_SHARED_PRIORITY_STACK, OsStackUser=IdleTask_OsCore0
          OsCore0_Task_Prio100: OsStackSize=1024, OsStackType=TASK_SHARED_PRIORITY_STACK, OsStackUser=Default_Init_Task
          OsTask_BSW_SCHM: OsStackSize=1024, OsStackType=TASK_SHARED_PRIORITY_STACK, OsStackUser=Os/OsTask_BSW_SCHM
          OsTask_APP: OsStackSize=1024, OsStackType=TASK_SHARED_PRIORITY_STACK, OsStackUser=Os/OsTask_APP
          OsTask_EMC_PWL_CCC: OsStackSize=1024, OsStackType=TASK_SHARED_PRIORITY_STACK, OsStackUser=Os/OsTask_EMC_PWL_CCC
          OsCore0_Task_Prio20: OsStackSize=1024, OsStackType=TASK_SHARED_PRIORITY_STACK, OsStackUser=OsTask_CPULoad_1S
          OsCore0_Task_Prio25: OsStackSize=1024, OsStackType=TASK_SHARED_PRIORITY_STACK, OsStackUser=OsTask_LOCK_100ms
      OsHooks: OsErrorHook=true, OsPostTaskHook=false, OsPreTaskHook=false, OsShutdownHook=false, OsStartupHook=false, OsPanicHook=true, OsProtectionHook=false
    SystemTimer (OsCounter):
      OsCounterMaxAllowedValue = 2147483647
      OsCounterMinCycle = 1
      OsCounterType = HARDWARE
      OsSecondsPerTick = 0.001
      OsCounterTicksPerBase = 80000
      OsCounterAccessingApplication = SystemApplication_OsCore0
      OsDriver: OsDriverHighResolution=false, OsDriverIsrRef=CounterIsr_SystemTimer, OsDriverHardwareTimerChannelRef=SysTick_Ch0
    4 x OsIsr, all with OsIsrCategory=CATEGORY_2, OsIsrInterruptType=EXTERNAL, OsIsrStackSize=1024, OsIsrEnableNesting=false, OsIsrUsesFpu=false, OsIsrInterruptMapping=DEFAULT:
      CounterIsr_SystemTimer: OsIsrInterruptPriority=32, OsIsrInterruptSource=15, OsIsrSpecialFunctionName=Os_TimerPitIsr
      CanIsr_0_BusOff: OsIsrInterruptSource=94, OsIsrInterruptPriority=81, OsIsrSpecialFunctionName=CanBusOffIsr_0  # /ActiveEcuC/Can PLAIN_TEXT CAN BusOff Interrupt. This OsIsr container has been created automatically based on the driver configuration.
      CanIsr_0_MB16To31: OsIsrInterruptSource=98, OsIsrInterruptPriority=79, OsIsrSpecialFunctionName=CanMailboxIsr_0  # /ActiveEcuC/Can PLAIN_TEXT CAN Tx and Rx Interrupt. This OsIsr container has been created automatically based on the driver configuration.
      CanIsr_0_MB00To15: OsIsrInterruptSource=97, OsIsrInterruptPriority=80, OsIsrSpecialFunctionName=CanMailboxIsr_0  # /ActiveEcuC/Can PLAIN_TEXT CAN Tx and Rx Interrupt. This OsIsr container has been created automatically based on the driver configuration.
    OsCore0 (OsCore):
      OsCoreIsAutostart = true
      OsCoreIsAutosar = true
      OsCoreEntrySymbol = Reset_Handler
      OsCorePhysicalCoreRef = Core0
      OsCoreEcucCoreRef = EcucCoreDefinition
      OsCoreIdleTask = IdleTask_OsCore0
      OsCoreSystemApplication = SystemApplication_OsCore0
      OsCoreStacks:
        OsCoreKernelStackSize = 2048
        OsCoreStartupStackSize = 2048
        OsCoreShutdownStackSize = 1024
        OsCoreErrorStackSize = 1024
        OsCoreProtectionStackSize = 1024
        OsCoreInitStackSize = 2048
    IdleTask_OsCore0 (OsTask):
      OsTaskActivation = 1
      OsTaskPriority = 4294967295
      OsTaskSchedule = FULL
      OsTaskStackSharing = false
      OsTaskStackSize = 1024
      OsTaskType = AUTO
      OsTaskUsesFpu = false
      OsTaskAccessingApplication = SystemApplication_OsCore0
      OsTaskAutostart: OsTaskAppModeRef=OSDEFAULTAPPMODE, OsTaskAppModeRef=OS_APPMODE_ANY
    SystemApplication_OsCore0 (OsApplication):
      OsTrusted = true
      OsTrustedApplicationDelayTimingViolationCall = false
      OsTrustedApplicationWithProtection = false
      OsApplicationIsPrivileged = true
      OsAppUseTrustedFunctionStubs = false
      OsApplicationCoreRef = EcucCoreDefinition
      OsAppIsrRef = CanIsr_0_BusOff
      OsAppIsrRef = CanIsr_0_MB00To15
      OsAppCounterRef = SystemTimer
      OsAppIsrRef = CanIsr_0_MB16To31
      OsAppIsrRef = CounterIsr_SystemTimer
      OsAppTaskRef = IdleTask_OsCore0
      OsAppTaskRef = Default_Init_Task
      OsAppTaskRef = Os/OsTask_BSW_SCHM
      OsAppTaskRef = Os/OsTask_APP
      OsAppAlarmRef = Rte_Al_TE2_OsTask_BSW_SCHM_0_10ms
      OsAppAlarmRef = Rte_Al_TE2_OsTask_BSW_SCHM_0_20ms
      OsAppAlarmRef = Rte_Al_TE_CanTp_CanTp_MainFunction
      OsAppAlarmRef = Rte_Al_TE_CpLedTask_LedRunnable
      OsAppAlarmRef = Rte_Al_TE_Cdd_SBC_UJA1169_Sbc_Test_Runnable
      OsAppIsrRef = Adc_ConvertGroup0_lwt
      OsAppIsrRef = Gptlsr_LpitChannel0
      OsAppAlarmRef = Rte_Al_TE_OsTask_APP_0_50ms
      OsAppTaskRef = Os/OsTask_EMC_PWL_CCC
      OsAppTaskRef = OsTask_LOCK_100ms
      OsAppAlarmRef = Rte_Al_TE_CCC_CCC_expand_Runnable_2S
      OsAppAlarmRef = Rte_Al_TE_EMC_EMC_expand_Runnable_10ms
      OsAppAlarmRef = Rte_Al_TE_PWL_PWL_expand_Runnable_20ms
      OsAppAlarmRef = Rte_Al_TE_LOCK_LOCK_basic_Runnable
      OsApplicationHooks: OsAppErrorHook=false, OsAppShutdownHook=false, OsAppStartupHook=false
    OsResource: OsResourceProperty=STANDARD, OsResourceAccessingApplication=SystemApplication_OsCore0
    3 x OsTask, all with OsTaskActivation=1, OsTaskSchedule=NON, OsTaskStackSharing=false, OsTaskStackSize=1024, OsTaskUsesFpu=false, OsTaskAccessingApplication=SystemApplication_OsCore0:
      Default_Init_Task: OsTaskPriority=100, OsTaskType=BASIC
        OsTaskAutostart: OsTaskAppModeRef=OSDEFAULTAPPMODE
      OsTask_BSW_SCHM: OsTaskPriority=10, OsTaskType=AUTO, OsTaskResourceRef=OsResource, OsTaskEventRef=Rte_Ev_Cyclic2_OsTask_BSW_SCHM_0_10ms, OsTaskEventRef=Rte_Ev_Cyclic2_OsTask_BSW_SCHM_0_20ms, OsTaskEventRef=Rte_Ev_Run_CanTp_CanTp_MainFunction
      OsTask_APP: OsTaskPriority=15, OsTaskType=AUTO, OsTaskEventRef=Rte_Ev_Run_CpLedTask_LedRunnable, OsTaskEventRef=Rte_Ev_Run_Cdd_SBC_UJA1169_Sbc_Test_Runnable, OsTaskEventRef=Rte_Ev_Cyclic_OsTask_APP_0_50ms
    Rte_Al_TE2_OsTask_BSW_SCHM_0_10ms (OsAlarm): OsAlarmCounterRef=SystemTimer, OsAlarmAccessingApplication=SystemApplication_OsCore0
      OsAlarmAction
        OsAlarmSetEvent: OsAlarmSetEventRef=Rte_Ev_Cyclic2_OsTask_BSW_SCHM_0_10ms, OsAlarmSetEventTaskRef=Os/OsTask_BSW_SCHM
    Rte_Al_TE2_OsTask_BSW_SCHM_0_20ms (OsAlarm): OsAlarmCounterRef=SystemTimer, OsAlarmAccessingApplication=SystemApplication_OsCore0
      OsAlarmAction
        OsAlarmSetEvent: OsAlarmSetEventRef=Rte_Ev_Cyclic2_OsTask_BSW_SCHM_0_20ms, OsAlarmSetEventTaskRef=Os/OsTask_BSW_SCHM
    Rte_Ev_Cyclic2_OsTask_BSW_SCHM_0_10ms (OsEvent)
    Rte_Ev_Cyclic2_OsTask_BSW_SCHM_0_20ms (OsEvent)
    Rte_Al_TE_CpLedTask_LedRunnable (OsAlarm): OsAlarmCounterRef=SystemTimer, OsAlarmAccessingApplication=SystemApplication_OsCore0
      OsAlarmAction
        OsAlarmSetEvent: OsAlarmSetEventRef=Rte_Ev_Run_CpLedTask_LedRunnable, OsAlarmSetEventTaskRef=Os/OsTask_APP
    Rte_Ev_Run_CpLedTask_LedRunnable (OsEvent)
    Rte_Al_TE_Cdd_SBC_UJA1169_Sbc_Test_Runnable (OsAlarm): OsAlarmCounterRef=SystemTimer, OsAlarmAccessingApplication=SystemApplication_OsCore0
      OsAlarmAction
        OsAlarmSetEvent: OsAlarmSetEventRef=Rte_Ev_Run_Cdd_SBC_UJA1169_Sbc_Test_Runnable, OsAlarmSetEventTaskRef=Os/OsTask_APP
    Rte_Ev_Run_Cdd_SBC_UJA1169_Sbc_Test_Runnable (OsEvent)
    Rte_Al_TE_CanTp_CanTp_MainFunction (OsAlarm): OsAlarmCounterRef=SystemTimer, OsAlarmAccessingApplication=SystemApplication_OsCore0
      OsAlarmAction
        OsAlarmSetEvent: OsAlarmSetEventRef=Rte_Ev_Run_CanTp_CanTp_MainFunction, OsAlarmSetEventTaskRef=Os/OsTask_BSW_SCHM
    Rte_Ev_Run_CanTp_CanTp_MainFunction (OsEvent)
    Adc_ConvertGroup0_lwt (OsIsr):
      OsIsrCategory = CATEGORY_2
      OsIsrInterruptType = EXTERNAL
      OsIsrInterruptSource = 55
      OsIsrInterruptPriority = 70
      OsIsrStackSize = 1024
      OsIsrEnableNesting = false
      OsIsrUsesFpu = false
      OsIsrSpecialFunctionName = Adc_Adc12bsarv2_EndGroupConvUnit0
      OsIsrInterruptMapping = DEFAULT
    Gptlsr_LpitChannel0 (OsIsr):
      OsIsrCategory = CATEGORY_2
      OsIsrInterruptType = EXTERNAL
      OsIsrInterruptSource = 64
      OsIsrInterruptPriority = 71
      OsIsrStackSize = 1024
      OsIsrEnableNesting = false
      OsIsrUsesFpu = false
      OsIsrSpecialFunctionName = LPIT_0_CH_0_ISR
      OsIsrInterruptMapping = DEFAULT
    Rte_Al_TE_OsTask_APP_0_50ms (OsAlarm): OsAlarmCounterRef=SystemTimer, OsAlarmAccessingApplication=SystemApplication_OsCore0
      OsAlarmAction
        OsAlarmSetEvent: OsAlarmSetEventRef=Rte_Ev_Cyclic_OsTask_APP_0_50ms, OsAlarmSetEventTaskRef=Os/OsTask_APP
    Rte_Ev_Cyclic_OsTask_APP_0_50ms (OsEvent)
    OsTask_EMC_PWL_CCC (OsTask):
      OsTaskActivation = 1
      OsTaskPriority = 20
      OsTaskSchedule = FULL
      OsTaskStackSharing = false
      OsTaskStackSize = 1024
      OsTaskType = EXTENDED
      OsTaskUsesFpu = false
      OsTaskAccessingApplication = SystemApplication_OsCore0
      OsTaskEventRef = Rte_Ev_Run_CCC_CCC_expand_Runnable_2S
      OsTaskEventRef = Rte_Ev_Run_EMC_EMC_expand_Runnable_10ms
      OsTaskEventRef = Rte_Ev_Run_PWL_PWL_expand_Runnable_20ms
    OsTask_LOCK_100ms (OsTask):
      OsTaskActivation = 3
      OsTaskPriority = 25
      OsTaskSchedule = FULL
      OsTaskStackSharing = false
      OsTaskStackSize = 1024
      OsTaskType = BASIC
      OsTaskUsesFpu = false
      OsTaskAccessingApplication = SystemApplication_OsCore0
    OsApplication_CPUMonitor (OsApplication):
      OsTrusted = true
      OsTrustedApplicationDelayTimingViolationCall = false
      OsTrustedApplicationWithProtection = false
      OsApplicationIsPrivileged = true
      OsAppUseTrustedFunctionStubs = false
      OsApplicationCoreRef = EcucCoreDefinition
      OsAppTaskRef = OsTask_CPULoad_1S
      OsAppAlarmRef = Rte_Al_TE_CPULoad_CPUload_basic_Runnable_1S
      OsApplicationHooks: OsAppErrorHook=false, OsAppShutdownHook=false, OsAppStartupHook=false
    OsTask_CPULoad_1S (OsTask):
      OsTaskActivation = 3
      OsTaskPriority = 20
      OsTaskSchedule = FULL
      OsTaskStackSharing = false
      OsTaskStackSize = 1024
      OsTaskType = BASIC
      OsTaskUsesFpu = false
      OsTaskAccessingApplication = SystemApplication_OsCore0
    5 x OsAlarm, all with OsAlarmCounterRef=SystemTimer, OsAlarmAccessingApplication=SystemApplication_OsCore0:
      Rte_Al_TE_CPULoad_CPUload_basic_Runnable_1S
        OsAlarmAction
          OsAlarmActivateTask: OsAlarmActivateTaskRef=OsTask_CPULoad_1S
      Rte_Al_TE_CCC_CCC_expand_Runnable_2S
        OsAlarmAction
          OsAlarmSetEvent: OsAlarmSetEventRef=Rte_Ev_Run_CCC_CCC_expand_Runnable_2S, OsAlarmSetEventTaskRef=Os/OsTask_EMC_PWL_CCC
      Rte_Al_TE_EMC_EMC_expand_Runnable_10ms
        OsAlarmAction
          OsAlarmSetEvent: OsAlarmSetEventRef=Rte_Ev_Run_EMC_EMC_expand_Runnable_10ms, OsAlarmSetEventTaskRef=Os/OsTask_EMC_PWL_CCC
      Rte_Al_TE_PWL_PWL_expand_Runnable_20ms
        OsAlarmAction
          OsAlarmSetEvent: OsAlarmSetEventRef=Rte_Ev_Run_PWL_PWL_expand_Runnable_20ms, OsAlarmSetEventTaskRef=Os/OsTask_EMC_PWL_CCC
      Rte_Al_TE_LOCK_LOCK_basic_Runnable
        OsAlarmAction
          OsAlarmActivateTask: OsAlarmActivateTaskRef=OsTask_LOCK_100ms
    3 x OsEvent:
      Rte_Ev_Run_CCC_CCC_expand_Runnable_2S
      Rte_Ev_Run_EMC_EMC_expand_Runnable_10ms
      Rte_Ev_Run_PWL_PWL_expand_Runnable_20ms
