AUTOSAR XML (schema 4-2-1)
package /ActiveEcuC
  module config CanIf: implementation-config-variant=VARIANT-PRE-COMPILE, module-description=CanIf_Impl
    CanIfCtrlDrvCfg_7d254554 (CanIfCtrlDrvCfg): CanIfCtrlDrvTxCancellation=false, CanIfCtrlDrvInitHohConfigRef=CanIfInitHohCfg, CanIfCtrlDrvNameRef=CanGeneral
      CT_CAN00_9df8a959 (CanIfCtrlCfg): CanIfCtrlId=0, CanIfCtrlWakeupSupport=false, CanIfCtrlJ1939DynAddrSupport=DISABLED, CanIfCtrlCanCtrlRef=CT_CAN00_9df8a959
    CanIfDispatchCfg:
      CanIfDispatchUserCtrlBusOffName = CanSM_ControllerBusOff
      CanIfDispatchUserCtrlBusOffUL = CAN_SM
      CanIfDispatchUserCtrlModeIndicationName = CanSM_ControllerModeIndication
      CanIfDispatchUserCtrlModeIndicationUL = CAN_SM
    CanIfInitCfg
      3 x CanIfTxPduCfg, all with CanIfTxPduCanIdType=STANDARD_CAN, CanIfTxPduReadNotifyStatus=false, CanIfTxPduType=STATIC, CanIfTxPduBufferRef=CHNL_0fb271d2:
        msg_diag_Response_MyECU_Tp_oCAN00_59e48f7a_Tx: CanIfTxPduCanId=1554, CanIfTxPduDlc=8, CanIfTxPduUserTxConfirmationName=CanTp_TxConfirmation, CanIfTxPduUserTxConfirmationUL=CAN_TP, CanIfTxPduId=0, CanIfTxPduRef=msg_diag_Response_MyECU_Tp_oCAN00_0ed9d144_Tx
        msg_MyECU_Lamp_oCAN00_41befc25_Tx: CanIfTxPduCanId=1297, CanIfTxPduDlc=8, CanIfTxPduUserTxConfirmationName=PduR_CanIfTxConfirmation, CanIfTxPduUserTxConfirmationUL=PDUR, CanIfTxPduId=2, CanIfTxPduRef=msg_MyECU_Lamp_oCAN00_26f3473b_Tx
        msg_Transmit_oCAN00_29db34a4_Tx: CanIfTxPduCanId=512, CanIfTxPduDlc=1, CanIfTxPduUserTxConfirmationName=PduR_CanIfTxConfirmation, CanIfTxPduUserTxConfirmationUL=PDUR, CanIfTxPduId=4, CanIfTxPduRef=msg_Transmit_oCAN00_9631a86b_Tx
      msg_diag_RequestGlobal_Tp_oCAN00_5c56b065_Rx (CanIfRxPduCfg):
        CanIfRxPduCanId = 1556
        CanIfRxPduCanIdType = STANDARD_CAN
        CanIfRxPduDlc = 8
        CanIfRxPduUserRxIndicationName = CanTp_RxIndication
        CanIfRxPduUserRxIndicationType = PDUID_PDUINFOPTR
        CanIfRxPduUserRxIndicationUL = CAN_TP
        CanIfRxPduId = 0
        CanIfRxPduReadData = false
        CanIfRxPduReadNotifyStatus = false
        CanIfRxPduDlcCheck = true
        CanIfRxPduHrhIdRef = CN_CAN00_770af0b0_Rx
        CanIfRxPduRef = msg_diag_RequestGlobal_Tp_oCAN00_7b1e9193_Rx
      CHNL_0fb271d2 (CanIfBufferCfg):
        CanIfBufferSize = 4
        CanIfTxBufferHandlingType = PRIO_BY_CANID
        CanIfTxBufferMappedTxPdus = 4
        CanIfTxBufferMaxPduLength = 8
        CanIfBufferHthRef = CN_CAN00_5e566ad9_Tx
      msg_diag_Request_MyECU_Tp_oCAN00_2c5ccddc_Rx (CanIfRxPduCfg):
        CanIfRxPduCanId = 1552
        CanIfRxPduCanIdType = STANDARD_CAN
        CanIfRxPduDlc = 8
        CanIfRxPduUserRxIndicationName = CanTp_RxIndication
        CanIfRxPduUserRxIndicationType = PDUID_PDUINFOPTR
        CanIfRxPduUserRxIndicationUL = CAN_TP
        CanIfRxPduId = 1
        CanIfRxPduReadData = false
        CanIfRxPduReadNotifyStatus = false
        CanIfRxPduDlcCheck = true
        CanIfRxPduHrhIdRef = CN_CAN00_770af0b0_Rx
        CanIfRxPduRef = msg_diag_Request_MyECU_Tp_oCAN00_ecbacca2_Rx
      CanIfInitHohCfg: CanIfInitRefCfgSet=CanConfigSet
        CN_CAN00_5e566ad9_Tx (CanIfHthCfg): CanIfHthCanCtrlIdRef=CT_CAN00_9df8a959, CanIfHthIdSymRef=CN_CAN00_5e566ad9_Tx
        CN_CAN00_770af0b0_Rx (CanIfHrhCfg): CanIfHrhSoftwareFilter=true, CanIfHrhCanCtrlIdRef=CT_CAN00_9df8a959, CanIfHrhIdSymRef=CN_CAN00_770af0b0_Rx
        Can_Network_Tx_Mailbox (CanIfHthCfg): CanIfHthCanCtrlIdRef=CT_CAN00_9df8a959, CanIfHthIdSymRef=Can_Network_Tx_Mailbox
      msg_Receive_oCAN00_76f25845_Rx (CanIfRxPduCfg):
        CanIfRxPduCanId = 528
        CanIfRxPduCanIdType = STANDARD_CAN
        CanIfRxPduDlc = 1
        CanIfRxPduUserRxIndicationName = PduR_CanIfRxIndication
        CanIfRxPduUserRxIndicationUL = PDUR
        CanIfRxPduId = 3
        CanIfRxPduReadData = false
        CanIfRxPduReadNotifyStatus = false
        CanIfRxPduDlcCheck = true
        CanIfRxPduHrhIdRef = CN_CAN00_770af0b0_Rx
        CanIfRxPduRef = msg_Receive_oCAN00_3867e0b8_Rx
      myECU2_Canif_CAN_Network (CanIfTxPduCfg):
        CanIfTxPduCanId = 1536
        CanIfTxPduCanIdType = STANDARD_CAN
        CanIfTxPduDlc = 8
        CanIfTxPduId = 1
        CanIfTxPduReadNotifyStatus = false
        CanIfTxPduType = STATIC
        CanIfTxPduUserTxConfirmationUL = PDUR
        CanIfTxPduUserTxConfirmationName = PduR_CanIfTxConfirmation
        CanIfTxPduBufferRef = Buffer_Can_Network_Tx_Mailbox
        CanIfTxPduRef = myECU2_ipdu_pdurTocanif
      Buffer_Can_Network_Tx_Mailbox (CanIfBufferCfg):
        CanIfBufferSize = 1
        CanIfTxBufferHandlingType = PRIO_BY_CANID
        CanIfTxBufferMappedTxPdus = 1
        CanIfTxBufferMaxPduLength = 8
        CanIfBufferHthRef = Can_Network_Tx_Mailbox
      lwt_msg_recv2_oCAN00_01dd45b9_Rx (CanIfRxPduCfg):
        CanIfRxPduCanId = 544
        CanIfRxPduCanIdType = STANDARD_CAN
        CanIfRxPduDlc = 8
        CanIfRxPduUserRxIndicationName = PduR_CanIfRxIndication
        CanIfRxPduUserRxIndicationUL = PDUR
        CanIfRxPduId = 2
        CanIfRxPduReadData = false
        CanIfRxPduReadNotifyStatus = false
        CanIfRxPduDlcCheck = true
        CanIfRxPduHrhIdRef = CN_CAN00_770af0b0_Rx
        CanIfRxPduRef = lwt_msg_recv2_oCAN00_6ed96947_Rx
      lwt_msg_transmit2_oCAN00_cd5f90fe_Tx (CanIfTxPduCfg):
        CanIfTxPduCanId = 784
        CanIfTxPduCanIdType = STANDARD_CAN
        CanIfTxPduDlc = 1
        CanIfTxPduUserTxConfirmationName = PduR_CanIfTxConfirmation
        CanIfTxPduUserTxConfirmationUL = PDUR
        CanIfTxPduId = 3
        CanIfTxPduReadNotifyStatus = false
        CanIfTxPduType = STATIC
        CanIfTxPduBufferRef = CHNL_0fb271d2
        CanIfTxPduRef = lwt_msg_transmit2_oCAN00_3f89428f_Tx
    CanIfPrivateCfg:
      CanIfPrivateSoftwareFilterType = LINEAR
      CanIfPrivateDlcCheck = true
      CanIfSupportTTCAN = false
      CanIfTransceiverMapping = false
      CanIfTransceiverHandling = false
      CanIfSupportExtendedIds = true
      CanIfSupportNmOsek = false
      CanIfTxBufferType = BYTE_QUEUE
      CanIfOptimizeOneController = true
      CanIfWakeupSupport = false
      CanIfStaticFdTxBufferSupport = false
      CanIfRxSearchConsiderMsgType = false
      CanIfMultipleBasicCANTxObjects = true
      CanIfTxBufferFifoSupport = false
      CanIfSetPduReceptionModeSupport = false
      CanIfDataChecksumRxSupport = false
      CanIfDataChecksumTxSupport = false
    CanIfPublicCfg:
      CanIfPublicPnSupport = false
      CanIfPublicCancelTransmitSupport = false
      CanIfPublicDevErrorDetect = true
      CanIfPublicHandleTypeEnum = UINT8
      CanIfPublicMultipleDrvSupport = false
      CanIfPublicNumberOfCanHwUnits = 1
      CanIfPublicReadRxPduDataApi = false
      CanIfPublicReadRxPduNotifyStatusApi = false
      CanIfPublicReadTxPduNotifyStatusApi = false
      CanIfPublicSetDynamicTxIdApi = false
      CanIfPublicTxBuffering = true
      CanIfPublicTxConfirmPollingSupport = false
      CanIfPublicVersionInfoApi = false
      CanIfPublicWakeupCheckValidSupport = false
      CanIfPnWakeupTxPduFilterSupport = false
      CanIfPnTrcvHandlingSupport = false
      CanIfJ1939DynAddrSupport = DISABLED
      CanIfSafeBswChecks = false
      CanIfSetBaudrateApi = false
