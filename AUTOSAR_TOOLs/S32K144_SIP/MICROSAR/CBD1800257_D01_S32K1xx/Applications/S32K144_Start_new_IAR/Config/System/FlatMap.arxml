AUTOSAR XML (schema 4-2-1)
package /COM/VECTOR/CFG/WORKFLOW/SYSDESC/SYNC
  flat map FLATMAP
    9 x flat instance descriptor:
      CpLedTask: upstream-reference=EcuSwComposition.CpLedTask, ecu-extract-reference=COMPOSITIONTYPE.CpLedTask
      Cdd_SBC_UJA1169: upstream-reference=EcuSwComposition.Cdd_SBC_UJA1169, ecu-extract-reference=COMPOSITIONTYPE.Cdd_SBC_UJA1169
      Test_SWC: upstream-reference=EcuSwComposition.Test_SWC, ecu-extract-reference=COMPOSITIONTYPE.Test_SWC
      Test2_SWC: upstream-reference=EcuSwComposition.Test2_SWC, ecu-extract-reference=COMPOSITIONTYPE.Test2_SWC
      EMC: upstream-reference=EcuSwComposition.EMC, ecu-extract-reference=COMPOSITIONTYPE.EMC
      PWL: upstream-reference=EcuSwComposition.PWL, ecu-extract-reference=COMPOSITIONTYPE.PWL
      LOCK: upstream-reference=EcuSwComposition.LOCK, ecu-extract-reference=COMPOSITIONTYPE.LOCK
      CPULoad: upstream-reference=EcuSwComposition.CPULoad, ecu-extract-reference=COMPOSITIONTYPE.CPULoad
      CCC: upstream-reference=EcuSwComposition.CCC, ecu-extract-reference=COMPOSITIONTYPE.CCC
