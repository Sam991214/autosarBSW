AUTOSAR XML (schema 00044)
package /COM/VECTOR/CFG/WORKFLOW/SYSDESC/SYNC
  system SYSTEM: category=ECU_EXTRACT
    system mapping MAPPINGS
      data-mappings:
        data-element=CpLedTask.COMPOSITIONTYPE.lwt_Lampcnt.u8_lwt_Signal, system-signal=sig_LampCnt
        data-element=CpLedTask.COMPOSITIONTYPE.lwt_RearInterLight.Bool_lwtSignal, system-signal=sig_RearInteriorLight
        data-element=CpLedTask.COMPOSITIONTYPE.lwt_develop_FrongLight.bool_signal_lwt_develop, system-signal=lwt_sig_trans2_FrongLight
        data-element=CpLedTask.COMPOSITIONTYPE.lwt_develop_RearLeftWinPos.u8_signal_lwt_develop, system-signal=lwt_sig_recv2_RearLeftWinPos
        data-element=CpLedTask.COMPOSITIONTYPE.lwt_develop_RearRightWinPos.u8_signal_lwt_develop, system-signal=lwt_sig_recv2_RearRightWinPos
    root-software-compositions:
      root sw composition prototype COMPOSITIONTYPE: flat-map=FLATMAP, software-composition=COMPOSITIONTYPE
  composition sw component type COMPOSITIONTYPE  # UB:Derived from original system description
    17 x component:
      BswM: type=BswM
      ComM: type=ComM
      Det: type=Det
      EcuM: type=EcuM
      Os_OsCore0_swc: type=Os_OsCore0_swc
      DemMaster_0: type=DemMaster_0
      DemSatellite_0: type=DemSatellite_0
      Dcm: type=Dcm
      CpLedTask: type=CtLedTask
      Cdd_SBC_UJA1169: type=CddSbc
      Test_SWC: type=Test_SWC
      Test2_SWC: type=Test_SWC2
      EMC: type=EMC_expand
      PWL: type=PWL_expand
      LOCK: type=LOCK_basic
      CPULoad: type=CPUload_basic
      CCC: type=CCC_expand
    connect BswM.Switch_ESH_ModeSwitch -> BswM.Notification_ESH_ModeNotification
    connect ComM.UR_CN_CAN00_06ecbb07 -> CpLedTask.UR_CN_CAN00_06ecbb07
    connect Test2_SWC.lwt_Test_Swc2_Write -> Test_SWC.lwt_Test_Swc_Read  # UB:Derived from original system description
    connect Test_SWC.lwt_Test_Swc_Write -> Test2_SWC.lwt_Test_Swc2_Read  # UB:Derived from original system description
    connect Test_SWC.Test_SWC_Service -> Test2_SWC.Test_SWC_Service  # UB:Derived from original system description
  end to end protection set E2EPROTECTIONSET
  port interface mapping set PORTINTERFACEMAPPINGSET
