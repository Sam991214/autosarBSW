AUTOSAR XML (schema 00044)
package /ComponentTypes
  application sw component type PWL_expand
    behavior PWL_expand_InternalBehavior
      timing event TMT_PWL_expand_Runnable_20ms: start-on-event=PWL_expand_Runnable_20ms, period=0.02
      runnable PWL_expand_Runnable_20ms: minimum-start-interval=0.02
  swc implementation PWL_expand_Implementation: behavior=PWL_expand_InternalBehavior
