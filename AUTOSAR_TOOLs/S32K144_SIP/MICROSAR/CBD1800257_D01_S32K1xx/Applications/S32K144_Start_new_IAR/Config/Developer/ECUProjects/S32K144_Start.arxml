AUTOSAR XML (schema 00044)
package /VehicleProject
  system System
    root-software-compositions:
      root sw composition prototype EcuSwComposition: software-composition=ECU_Composition
package /ECUCompositionTypes
  composition sw component type ECU_Composition
    9 x component:
      CpLedTask: type=CtLedTask
      Cdd_SBC_UJA1169: type=CddSbc
      Test_SWC: type=Test_SWC
      Test2_SWC: type=Test_SWC2
      EMC: type=EMC_expand
      PWL: type=PWL_expand
      LOCK: type=LOCK_basic
      CPULoad: type=CPUload_basic
      CCC: type=CCC_expand
    connect Test2_SWC.lwt_Test_Swc2_Write -> Test_SWC.lwt_Test_Swc_Read
    connect Test_SWC.lwt_Test_Swc_Write -> Test2_SWC.lwt_Test_Swc2_Read
    connect Test_SWC.Test_SWC_Service -> Test2_SWC.Test_SWC_Service
package /EndToEndProtections
  end to end protection set EndToEndProtectionSet
