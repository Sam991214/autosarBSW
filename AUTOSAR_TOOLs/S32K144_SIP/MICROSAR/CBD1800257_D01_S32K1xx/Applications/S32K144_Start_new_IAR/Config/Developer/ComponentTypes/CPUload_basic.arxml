AUTOSAR XML (schema 00044)
package /ComponentTypes
  application sw component type CPUload_basic
    behavior CPUload_basic_InternalBehavior
      timing event TMT_CPUload_basic_Runnable_1S: start-on-event=CPUload_basic_Runnable_1S, period=1
      runnable CPUload_basic_Runnable_1S: minimum-start-interval=1
  swc implementation CPUload_basic_Implementation: behavior=CPUload_basic_InternalBehavior
