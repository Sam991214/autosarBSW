AUTOSAR XML (schema 00044)
package /ComponentTypes
  application sw component type LOCK_basic
    behavior LOCK_basic_InternalBehavior
      timing event TMT_LOCK_basic_Runnable: start-on-event=LOCK_basic_Runnable, period=0.1
      runnable LOCK_basic_Runnable: minimum-start-interval=0.1
  swc implementation LOCK_basic_Implementation: behavior=LOCK_basic_InternalBehavior
