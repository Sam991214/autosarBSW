AUTOSAR XML (schema 00044)
package /ComponentTypes
  application sw component type CCC_expand
    behavior CCC_expand_InternalBehavior
      timing event TMT_CCC_expand_Runnable_2S: start-on-event=CCC_expand_Runnable_2S, period=2
      runnable CCC_expand_Runnable_2S: minimum-start-interval=2
  swc implementation CCC_expand_Implementation: behavior=CCC_expand_InternalBehavior
