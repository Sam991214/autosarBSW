AUTOSAR XML (schema 00044)
package /ComponentTypes
  application sw component type EMC_expand
    behavior EMC_expand_InternalBehavior
      timing event TMT_EMC_expand_Runnable_10ms: start-on-event=EMC_expand_Runnable_10ms, period=0.01
      runnable EMC_expand_Runnable_10ms: minimum-start-interval=0.01
  swc implementation EMC_expand_Implementation: behavior=EMC_expand_InternalBehavior
